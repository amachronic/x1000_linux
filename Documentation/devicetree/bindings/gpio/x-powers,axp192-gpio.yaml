## Documentation/devicetree/bindings/gpio/x-powers,axp192-gpio.yaml
```yaml
# SPDX-License-Identifier: GPL-2.0-only OR BSD-2-Clause
%YAML 1.2
---
$id: http://devicetree.org/schemas/gpio/x-powers,axp192-gpio.yaml#
$schema: http://devicetree.org/meta-schemas/core.yaml#

title: X-Powers AXP192 GPIO Device Tree Bindings

maintainers:
  - Chen-Yu Tsai <wens@csie.org>

properties:
  compatible:
    const: x-powers,axp192-gpio

  gpio-controller: true

  "#gpio-cells":
    const: 2
    description: >
      The first cell is the pin number and the second is the GPIO flags.

  gpio-ranges:
    maxItems: 1

patternProperties:
  "-pins$":
    $ref: /schemas/pinctrl/pinmux-node.yaml#

    properties:
      pins:
        items:
          enum:
            - GPIO0
            - GPIO1
            - GPIO2
            - GPIO3
            - GPIO4
            - N_RSTO

      function:
        enum:
          - output
          - input
          - ldo
          - pwm
          - adc
          - low_output
          - floating
          - ext_chg_ctl
          - ldo_status

required:
  - compatible
  - "#gpio-cells"
  - gpio-controller
  - gpio-ranges

additionalProperties: false

examples:
  - |
    pinctrl0: gpio {
        compatible = "x-powers,axp192-gpio";
        gpio-controller;
        #gpio-cells = <2>;
        gpio-ranges = <&pinctrl0 0 0 6>;
    };
```

## Documentation/devicetree/bindings/rtc/ingenic,rtc.yaml
```yaml
# SPDX-License-Identifier: (GPL-2.0-only OR BSD-2-Clause)
%YAML 1.2
---
$id: http://devicetree.org/schemas/rtc/ingenic,rtc.yaml#
$schema: http://devicetree.org/meta-schemas/core.yaml#

title: Ingenic SoCs Real-Time Clock DT bindings

maintainers:
  - Paul Cercueil <paul@crapouillou.net>

allOf:
  - $ref: rtc.yaml#

properties:
  compatible:
    oneOf:
      - enum:
          - ingenic,jz4740-rtc
          - ingenic,jz4760-rtc
      - items:
          - const: ingenic,jz4725b-rtc
          - const: ingenic,jz4740-rtc
      - items:
          - enum:
              - ingenic,jz4770-rtc
              - ingenic,jz4780-rtc
          - const: ingenic,jz4760-rtc

  reg:
    maxItems: 1

  interrupts:
    maxItems: 1

  clocks:
    maxItems: 1

  clock-names:
    const: rtc

  system-power-controller:
    description: |
      Indicates that the RTC is responsible for powering OFF
      the system.
    type: boolean

  ingenic,reset-pin-assert-time-ms:
    minimum: 0
    maximum: 125
    default: 60
    description: |
      Reset pin low-level assertion time after wakeup
      (assuming RTC clock at 32 kHz)

  ingenic,min-wakeup-pin-assert-time-ms:
    minimum: 0
    maximum: 2000
    default: 100
    description: |
      Minimum wakeup pin assertion time
      (assuming RTC clock at 32 kHz)

  ingenic,rtc-valid-value:
    $ref: /schemas/types.yaml#/definitions/uint32
    description:
      Value compared against the RTC scratchpad register to detect
      if a power loss has occurred since the RTC was last set. If
      the register doesn't contain this value, the RTC setting is
      assumed to be invalid. Setting the RTC writes this value to
      the scratchpad register.

required:
  - compatible
  - reg
  - interrupts
  - clocks
  - clock-names
  - ingenic,rtc-valid-value

unevaluatedProperties: false

examples:
  - |
    #include <dt-bindings/clock/ingenic,jz4740-cgu.h>
    rtc_dev: rtc@10003000 {
      compatible = "ingenic,jz4740-rtc";
      reg = <0x10003000 0x40>;

      interrupt-parent = <&intc>;
      interrupts = <15>;

      clocks = <&cgu JZ4740_CLK_RTC>;
      clock-names = "rtc";
    };
```

## Documentation/devicetree/bindings/sound/ess,es9218p.yaml
```yaml
# SPDX-License-Identifier: (GPL-2.0-only OR BSD-2-Clause)
%YAML 1.2
---
$id: http://devicetree.org/schemas/sound/ess,es9218p.yaml#
$schema: http://devicetree.org/meta-schemas/core.yaml#

title: ESS ES9218P audio codec

maintainers:
  - Aidan MacDonald <aidanmacdonald.0x0@gmail.com>

allOf:
  - $ref: dai-common.yaml#

properties:
  compatible:
    const: ess,es9218p

  reg:
    maxItems: 1

  "#sound-dai-cells":
    const: 0

  avdd-supply:
    description:
      Digital core power supply.

  vcca-supply:
    description:
      Oscillator and DAC power supply.

  avcc3v3-supply:
    description:
      3.3V regulator for amplifier, switch, and charge pumps.

  avcc1v8-supply:
    description:
      1.8V regulator for amplifier, switch, and charge pumps.

  clocks:
    items:
      - description: clock for master clock (MCLK)

  reset-gpios:
    maxItems: 1
    description:
      Pin used for codec hardware reset, corresponds to the RESETB pin.

  ess,max-clock-div:
    $ref: /schemas/types.yaml#/definitions/uint32
    description:
      Sets the maximum MCLK divider for generating the internal CLK.
      CLK must be at least 20x the I2C bus speed or I2C transactions
      will fail. The maximum divider should be chosen to ensure that
      CLK will not fall below the limit.
    enum:
      - 1
      - 2
      - 4
      - 8
    default: 1

  ess,oscillator-pad-bias:
    $ref: /schemas/types.yaml#/definitions/uint32
    description: Sets the oscillator pad drive bias. 0 - full bias, 15 - disabled.
    minimum: 0
    maximum: 15
    default: 0

required:
  - compatible
  - reg
  - "#sound-dai-cells"
  - avdd-supply
  - vcca-supply
  - avcc3v3-supply
  - avcc1v8-supply
  - clocks
  - reset-gpios

unevaluatedProperties: false

examples:
  - |
    #include <dt-bindings/gpio/gpio.h>
    i2c {
        #address-cells = <1>;
        #size-cells = <0>;
        codec@48 {
            compatible = "ess,es9218p";
            reg = <0x48>;
            #sound-dai-cells = <0>;
            avdd-supply = <&avdd>;
            vcca-supply = <&vcca>;
            avcc3v3-supply = <&avcc3v3>;
            avcc1v8-supply = <&avcc1v8>;
            clocks = <&xtal_clock>;
            reset-gpios = <&gpio 1 GPIO_ACTIVE_LOW>;
        };
    };
```

## Documentation/devicetree/bindings/sound/ingenic,aic.yaml
```yaml
# SPDX-License-Identifier: (GPL-2.0-only OR BSD-2-Clause)
%YAML 1.2
---
$id: http://devicetree.org/schemas/sound/ingenic,aic.yaml#
$schema: http://devicetree.org/meta-schemas/core.yaml#

title: Ingenic SoCs AC97 / I2S Controller (AIC)

maintainers:
  - Paul Cercueil <paul@crapouillou.net>

allOf:
  - $ref: dai-common.yaml#

properties:
  $nodename:
    pattern: '^audio-controller@'

  compatible:
    oneOf:
      - enum:
          - ingenic,jz4740-i2s
          - ingenic,jz4760-i2s
          - ingenic,jz4770-i2s
          - ingenic,jz4780-i2s
      - items:
          - const: ingenic,jz4725b-i2s
          - const: ingenic,jz4740-i2s

  '#sound-dai-cells':
    const: 0

  reg:
    maxItems: 1

  interrupts:
    maxItems: 1

  clocks:
    items:
      - description: AIC clock
      - description: I2S clock

  clock-names:
    items:
      - const: aic
      - const: i2s

  dmas:
    items:
      - description: DMA controller phandle and request line for I2S RX
      - description: DMA controller phandle and request line for I2S TX

  dma-names:
    items:
      - const: rx
      - const: tx

unevaluatedProperties: false

required:
  - compatible
  - reg
  - interrupts
  - clocks
  - clock-names
  - dmas
  - dma-names
  - '#sound-dai-cells'

patternProperties:
  ingenic,codecs:
    $ref: /schemas/types.yaml#/definitions/uint32
    enum: [1, 2, 3]
    description:
      Bitmask describing which codec paths are valid. Macros specifying
      the codec bits can be found in <dt-bindings/sound/ingenic,aic.h>.
      Only two codec paths exist:

      * INGENIC_AIC_INTERNAL_CODEC_BIT (SoC internal codec)
      * INGENIC_AIC_EXTERNAL_CODEC_BIT (an external discrete codec)

      If the bit corresponding to a codec path is set, then that codec
      path can be used for audio playback or capture. The path actually
      used for playback or capture may be selected at runtime from the
      paths permitted by the DT.

  additionalProperties: false

  required:
    - ingenic,codecs

examples:
  - |
    #include <dt-bindings/clock/ingenic,jz4740-cgu.h>
    aic: audio-controller@10020000 {
      compatible = "ingenic,jz4740-i2s";
      reg = <0x10020000 0x38>;

      #sound-dai-cells = <0>;

      interrupt-parent = <&intc>;
      interrupts = <18>;

      clocks = <&cgu JZ4740_CLK_AIC>,
               <&cgu JZ4740_CLK_I2S>;
      clock-names = "aic", "i2s";

      dmas = <&dmac 25 0xffffffff>, <&dmac 24 0xffffffff>;
      dma-names = "rx", "tx";

      ingenic,codecs = <INGENIC_AIC_INTERNAL_CODEC_BIT>;
    };
```

## arch/mips/configs/shanlingq1_defconfig
```kconfig
CONFIG_DEFAULT_HOSTNAME="shanlingq1"
CONFIG_NO_HZ_IDLE=y
CONFIG_HIGH_RES_TIMERS=y
CONFIG_PREEMPT=y
CONFIG_EMBEDDED=y
CONFIG_MACH_INGENIC_SOC=y
CONFIG_X1000_SHANLINGQ1=y
CONFIG_BUILTIN_DTB=y
CONFIG_MIPS_NO_APPENDED_DTB=y
CONFIG_MIPS_CMDLINE_FROM_BOOTLOADER=y
CONFIG_SUSPEND=n
CONFIG_MODULES=y
CONFIG_MODULE_UNLOAD=y
CONFIG_NET=y
CONFIG_PACKET=y
CONFIG_UNIX=y
CONFIG_INET=y
CONFIG_DEVTMPFS=y
CONFIG_DEVTMPFS_MOUNT=y
CONFIG_INPUT=y
CONFIG_INPUT_EVDEV=y
CONFIG_INPUT_KEYBOARD=y
CONFIG_KEYBOARD_GPIO=y
CONFIG_INPUT_TOUCHSCREEN=y
CONFIG_TOUCHSCREEN_EDT_FT5X06=y
CONFIG_INPUT_MISC=y
CONFIG_INPUT_GPIO_ROTARY_ENCODER=y
CONFIG_HW_RANDOM=y
CONFIG_HW_RANDOM_INGENIC_RNG=y
CONFIG_I2C=y
CONFIG_I2C_JZ4780=y
CONFIG_POWER_SUPPLY=y
CONFIG_BATTERY_CW2015=y
CONFIG_CHARGER_AXP20X=y
CONFIG_BATTERY_AXP20X=y
CONFIG_AXP20X_POWER=y
CONFIG_WATCHDOG=y
CONFIG_JZ4740_WDT=y
CONFIG_MFD_AXP20X_I2C=y
CONFIG_REGULATOR=y
CONFIG_REGULATOR_FIXED_VOLTAGE=y
CONFIG_REGULATOR_AXP20X=y
CONFIG_BACKLIGHT_CLASS_DEVICE=y
CONFIG_BACKLIGHT_PWM=y
CONFIG_SOUND=y
CONFIG_SND=y
CONFIG_SND_SOC=y
CONFIG_SND_JZ4740_SOC_I2S=y
CONFIG_SND_SOC_ESS_ES9218P=y
CONFIG_SND_SIMPLE_CARD=y
CONFIG_USB_DWC2=y
CONFIG_USB_GADGET=y
CONFIG_USB_GADGET_VBUS_DRAW=500
CONFIG_MMC=y
CONFIG_MMC_JZ4740=y
CONFIG_RTC_CLASS=y
CONFIG_RTC_DRV_JZ4740=y
CONFIG_DMADEVICES=y
CONFIG_DMA_JZ4780=y
CONFIG_INGENIC_SYSOST=y
CONFIG_IIO=y
CONFIG_AXP20X_ADC=y
CONFIG_PWM=y
CONFIG_PWM_JZ4740=y
CONFIG_PHY_INGENIC_USB=y
CONFIG_EXT4_FS=y
CONFIG_VFAT_FS=y
CONFIG_EXFAT_FS=y
CONFIG_NTFS3_FS=y
CONFIG_TMPFS=y
CONFIG_NLS_CODEPAGE_437=y
CONFIG_NLS_ISO8859_1=y
CONFIG_NLS_UTF8=y
CONFIG_DEBUG_FS=y
```
